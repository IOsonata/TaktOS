## CMakeLists.txt
```
# SPDX-License-Identifier: MIT
#
# CMake configuration for the KVB benchmark suite as a Zephyr application.
#
# Board-agnostic.  The MCU and board are selected at build time via the
# -b flag to west, the same way every other Zephyr application works:
#
#   west build -p always -b nrf54l15dk/nrf54l15/cpuapp .
#   west build -p always -b nrf52840dk/nrf52840 .
#   west build -p always -b stm32l4r9i_iot01a .
#   west build -p always -b qemu_cortex_m3 .
#
# The application source is identical for every board.  Per-board
# overrides (Kconfig fragments, devicetree overlays) live in boards/
# and are auto-picked-up by Zephyr's build system based on the
# selected board target.
#
# After build, flash with:
#
#   west flash
#
# Connect a serial terminal at 115200 8N1 to the board's default
# console (whatever zephyr,chosen zephyr,console points at).  KVB
# emits its log lines via printk; output appears immediately on reset.

cmake_minimum_required(VERSION 3.20.0)

# Locate the KVB tree.  This CMakeLists.txt lives at:
#   KVB/Targets/Zephyr/KvbSuite/
# So three levels up is KVB/.
set(KVB_ROOT ${CMAKE_CURRENT_SOURCE_DIR}/../../..)

find_package(Zephyr REQUIRED HINTS $ENV{ZEPHYR_BASE})
project(kvb_zephyr LANGUAGES C CXX ASM)

# ----- KVB sources --------------------------------------------------------
# Core framework (kernel-agnostic).
target_sources(app PRIVATE
    ${KVB_ROOT}/src/core/kvb_default_tests.c
    ${KVB_ROOT}/src/core/kvb_log.c
    ${KVB_ROOT}/src/core/kvb_platform_default.c
    ${KVB_ROOT}/src/core/kvb_registry.c
    ${KVB_ROOT}/src/core/kvb_result.c
    ${KVB_ROOT}/src/core/kvb_runner.c
)

# Test bodies.
target_sources(app PRIVATE
    ${KVB_ROOT}/src/tests/sched/kvb_test_sched.c
    ${KVB_ROOT}/src/tests/sync/kvb_test_sync.c
    ${KVB_ROOT}/src/tests/ipc/kvb_test_ipc.c
    ${KVB_ROOT}/src/tests/time/kvb_test_time.c
)

# Zephyr kernel port — provides KvbThread/Sem/Mutex/Queue using k_*.
target_sources(app PRIVATE
    ${KVB_ROOT}/ports/kernels/zephyr/kvb_port_zephyr.c
)

# Generic Zephyr platform layer — board ID strings, microsecond clock,
# log routing.  Uses only Zephyr APIs and CONFIG_BOARD/CONFIG_SOC, so
# this single file works for every board.
target_sources(app PRIVATE
    src/kvb_platform_zephyr.c
)

# Application entry — calls kvb_zephyr_start_default() from main().
target_sources(app PRIVATE
    src/main.c
)

# ----- Include paths ------------------------------------------------------
target_include_directories(app PRIVATE
    ${KVB_ROOT}/include
    ${KVB_ROOT}/ports/kernels/zephyr
    ${KVB_ROOT}/src/tests
    include
)

# ----- KVB port identification -------------------------------------------
target_compile_definitions(app PRIVATE
    KVB_PORT_ZEPHYR=1
)

# ----- KVB knobs ---------------------------------------------------------
# kvb_config_zephyr.h is force-included into every TU so the Zephyr-
# build defaults (10 s window, 1024 B worker stacks, 2048 B runner
# stack, 5 workers) land before kvb_config.h's internal defaults.
#
# Per-board overrides — if a particular board needs different KVB knob
# values, drop them as -D defines in boards/<board>.conf via a
# per-board CMakeLists.txt fragment, OR add board-conditional blocks
# inside kvb_config_zephyr.h gated on CONFIG_BOARD_<NAME>.
target_compile_options(app PRIVATE
    -include kvb_config_zephyr.h
)
```

## prj.conf
```kconfig
# =============================================================================
# Zephyr Kconfig settings for the KVB benchmark suite — board-agnostic.
#
# These settings apply to every Zephyr board.  Per-board overrides (e.g.
# tighter stacks for low-RAM targets, devicetree alternatives for the
# console UART) belong in boards/<board>.conf and boards/<board>.overlay
# respectively.
#
# These settings are chosen for FEATURE PARITY with the other KVB ports
# (TaktOS, FreeRTOS V11.1+, Eclipse ThreadX 6.x).  See the KVB v3.0
# comparison report's methodology section for the full rationale.
#
# Equivalent runtime safety on every kernel:
#
#   - Stack overflow detection: always-on
#       TaktOS:    sentinel paint + check at every context switch
#       FreeRTOS:  configCHECK_FOR_STACK_OVERFLOW = 2 (canary)
#       ThreadX:   TX_ENABLE_STACK_CHECKING (sentinel)
#       Zephyr:    CONFIG_STACK_SENTINEL = y (software canary checked at
#                  every context switch, every k_yield(), every tick ISR
#                  for the interrupted thread, and every thread return).
#                  CONFIG_HW_STACK_PROTECTION (MPU stack guard) is NOT
#                  enabled — STACK_SENTINEL and MPU_STACK_GUARD are
#                  mutually exclusive in NCS Kconfig, and the software
#                  sentinel is the closer parity match to the always-on
#                  canary checks the other three RTOSes perform.
#
#   - API-entry runtime validation: each kernel ships with its own
#     design choice for where the kernel/application responsibility
#     line is drawn.  KVB keeps each kernel's native regime in place
#     rather than overriding any of them.  See the KVB comparison
#     report's §3.4 for the per-API breakdown; quick summary:
#       TaktOS:    hot-path checks at every public API entry: NULL on
#                  the handle (and pData on Queue Send / Receive),
#                  non-owner unlock rejection on every MutexUnlock
#                  (returns ERR_INVALID, no trap), and 4-byte
#                  alignment of pData on Queue Send / Receive
#                  (returns ERR_ALIGN; converts an unaligned-access
#                  HardFault on Cortex-M0 into a clean error return).
#                  Init APIs additionally range-check MaxCount /
#                  Initial / Ceiling / ItemSize / Capacity and
#                  pStorage alignment, but Init is not on the hot
#                  loop.  Slow / blocking paths add an ISR-context
#                  guard and a scheduler-ring corruption-detect
#                  inside TaktBlockTask.  TaktOS does not re-validate
#                  caller arguments beyond this list; the application
#                  owns its own argument validation.  Matches the
#                  IEC 61508 SIL 2 / ISO 26262 ASIL D boundary TaktOS
#                  targets.
#       FreeRTOS:  middle layer of caller-misuse defence.
#                  configASSERT inlined 3-4 times per public API
#                  (NULL + structural invariants like item-size /
#                  scheduler-state).
#       ThreadX:   exhaustive caller-misuse defence.  _txe_* wrapper
#                  adds a real C call frame plus 4-5 checks (NULL +
#                  object-ID + wait-option vs thread context +
#                  timer-thread + ISR posture).  Heaviest of the four.
#       Zephyr:    parameter validation in current Zephyr is split
#                  across two mechanisms; both are pinned ON for KVB
#                  to match what the other three RTOSes carry.
#                  (a) CHECKIF()  returned-error layer.  Controlled
#                  by the Kconfig choice "Error checking behavior
#                  for CHECK macro" (sys/check.h):
#                  RUNTIME_ERROR_CHECKS (default, returns -EINVAL
#                  on failure), ASSERT_ON_ERRORS (traps via
#                  __ASSERT_NO_MSG), or NO_RUNTIME_CHECKS (compile
#                  out).  Pinned RUNTIME_ERROR_CHECKS=y explicitly
#                  so prior build state / menuconfig cannot leave
#                  it disabled.  Coverage is narrow on the public
#                  surface: k_sem_init count/limit, k_mutex_unlock
#                  non-owner / unlocked-mutex, k_msgq_cleanup busy.
#                  (b) __ASSERT()  trap-on-misuse layer.  Controlled
#                  by CONFIG_ASSERT.  This is where most of
#                  Zephyr's API-entry runtime checks actually live
#                  in current Zephyr: k_sem_take ISR-vs-timeout,
#                  k_mutex_lock / k_mutex_unlock ISR + lock-count,
#                  k_msgq_put / k_msgq_get ISR-vs-timeout +
#                  internal pointer.  Pinned CONFIG_ASSERT=y so
#                  this layer stays active  setting it n compiles
#                  every __ASSERT out and leaves a strictly weaker
#                  validation surface than FreeRTOS / ThreadX /
#                  TaktOS.  Caveat: CONFIG_ASSERT=y also enables
#                  __ASSERTs inside scheduler / spinlock / wait-
#                  queue helpers the others have no equivalent of;
#                  there is no Kconfig granularity to split the two,
#                  so we accept the parity-correct build over a
#                  lighter but strictly-less-checked one.
#                  CONFIG_OBJ_CORE = n in this build, so per-object
#                  validity is not tracked (invalid_obj=0); same as
#                  FreeRTOS.
#
#   - Mutex priority inheritance: enabled
#       Zephyr:    unconditional in k_mutex (always-on in current Zephyr;
#                  no Kconfig switch — older guides referencing
#                  CONFIG_MUTEX_PRIORITY_INHERITANCE are out of date).
#                  CONFIG_PRIORITY_CEILING left at default (-127 = no
#                  cap on the inherited priority boost).
#
# Allocation strategy: static-only.  No heap, no dynamic kernel objects.

# -----------------------------------------------------------------------------
# Kernel scheduling shape
# -----------------------------------------------------------------------------
# Disable round-robin timeslicing — KVB tests rely on explicit yield to
# isolate cooperative scheduler latency from preemption events.
CONFIG_TIMESLICING=n

# Keep the Zephyr benchmark on a periodic 1 kHz system tick.  This matches the
# other KVB ports and keeps timeout behavior easier to compare.
CONFIG_TICKLESS_KERNEL=n

# 1000 Hz tick — matches every other KVB port.  TIME_SLEEP_001
# requested-vs-actual tolerance is computed against this tick period.
CONFIG_SYS_CLOCK_TICKS_PER_SEC=1000

# 15 preemptive priority levels.  KVB defines 5 canonical levels which
# the Zephyr port maps onto Zephyr's 0..14 preemptive range
# (numerically lower = higher urgency in Zephyr):
#       KVB_PRIORITY_HIGHEST -> 0
#       KVB_PRIORITY_HIGH    -> 3
#       KVB_PRIORITY_NORMAL  -> 7
#       KVB_PRIORITY_LOW     -> 11
#       KVB_PRIORITY_LOWEST  -> 14
CONFIG_NUM_PREEMPT_PRIORITIES=15

# Leave NUM_COOP_PRIORITIES at its default (16).  Forcing it to 0 breaks
# Zephyr internals (system workqueue, BLE host stack defaults, etc.)
# that place threads at negative priorities.

# -----------------------------------------------------------------------------
# Memory model: static allocation only
# -----------------------------------------------------------------------------
# Disable the system heap.  KVB never calls k_malloc(); all kernel
# objects are caller-supplied.
CONFIG_HEAP_MEM_POOL_SIZE=0

# -----------------------------------------------------------------------------
# Optimization (matches -Os elsewhere)
# -----------------------------------------------------------------------------
CONFIG_SIZE_OPTIMIZATIONS=y
CONFIG_SPEED_OPTIMIZATIONS=n

# -----------------------------------------------------------------------------
# Stack overflow detection (parity)
# -----------------------------------------------------------------------------
# Software stack sentinel ON: a magic word is written at the lowest
# address of every thread's stack at thread create, then re-checked on
# every context switch (outgoing thread), every k_yield(), every tick
# ISR for the interrupted thread, and every thread-entry return.  This
# is the closest functional match to the always-on canary checks
# performed by FreeRTOS (configCHECK_FOR_STACK_OVERFLOW=2), ThreadX
# (TX_ENABLE_STACK_CHECKING), and TaktOS's per-context-switch sentinel.
#
# CONFIG_HW_STACK_PROTECTION (MPU stack guard) is intentionally OFF —
# Zephyr's NCS layer makes STACK_SENTINEL depend on !MPU_STACK_GUARD,
# so enabling both produces a Kconfig warning and silently drops one of
# them.  We keep STACK_SENTINEL because it is the closest match to
# the canary-style checks the other three RTOSes use.
CONFIG_STACK_SENTINEL=y
CONFIG_HW_STACK_PROTECTION=n

# CONFIG_THREAD_STACK_INFO is auto-selected by STACK_SENTINEL — leave
# the explicit assignment off so Kconfig dependency resolution drives
# it.  CONFIG_INIT_STACKS (paint stacks at create time for stack-usage
# measurement, not stack-overflow detection) is OFF — none of the
# other three RTOSes do this and it would only show up as boot-time
# cost, not on the measured hot path.
CONFIG_INIT_STACKS=n

# Null-pointer dereference catch via DWT data watchpoint — left OFF
# because none of the other three RTOSes have a comparable feature.
# Enabling it would give Zephyr a hardware safety net the others lack
# and bias the comparison.
CONFIG_NULL_POINTER_EXCEPTION_DETECTION_DWT=n

# -----------------------------------------------------------------------------
# FPU
# -----------------------------------------------------------------------------
# Hard-float ABI matches the other three KVB ports
# (-mfpu=fpv4-sp-d16 -mfloat-abi=hard for arm-none-eabi-gcc).
# CONFIG_FPU_SHARING is auto-selected when CONFIG_FPU=y on multi-thread
# Zephyr builds — leave it implicit.
CONFIG_FPU=y
CONFIG_FP_HARDABI=y

# -----------------------------------------------------------------------------
# Parameter / handle validation at API entry (parity with FreeRTOS
# configASSERT, ThreadX _txe_* wrappers, and TaktOS's API-entry checks)
# -----------------------------------------------------------------------------
# Current Zephyr splits parameter validation across two mechanisms;
# both need to be enabled to match what the other three RTOSes carry.
#
# 1. CHECKIF()  returned-error path.  Controlled by the Kconfig
#    choice "Error checking behavior for CHECK macro" (sys/check.h):
#    RUNTIME_ERROR_CHECKS (default; check + return -EINVAL),
#    ASSERT_ON_ERRORS (trap via __ASSERT_NO_MSG), or NO_RUNTIME_CHECKS
#    (compile out).  Pinned RUNTIME_ERROR_CHECKS=y explicitly  more
#    robust than relying on the default, because prior build state /
#    menuconfig can leave the choice resolved differently.  CHECKIF
#    coverage on the public API surface is narrow (k_sem_init invalid
#    count/limit, k_mutex_unlock non-owner / unlocked-mutex,
#    k_msgq_cleanup busy).
#
# 2. __ASSERT()  trap-on-misuse path.  Controlled by CONFIG_ASSERT
#    (gates __ASSERT / __ASSERT_NO_MSG via __assert.h's __ASSERT_ON).
#    This is where most of the API-entry runtime checks actually
#    live in current Zephyr: k_sem_take ISR-vs-timeout, k_mutex_lock
#    / k_mutex_unlock ISR + lock-count, k_msgq_put / k_msgq_get ISR-
#    vs-timeout + internal pointer.  Pinned CONFIG_ASSERT=y so this
#    layer stays active  setting it n compiles every __ASSERT out
#    and leaves a strictly weaker validation surface than FreeRTOS
#    configASSERT, ThreadX _txe_*, or TaktOS's API-entry checks.
#    CONFIG_ASSERT_LEVEL defaults to 2 (check + print + halt); the
#    benchmark hot-path cost is the same as level 1 (check + print).
#
# Caveat: CONFIG_ASSERT=y also enables __ASSERTs inside scheduler /
# spinlock / wait-queue helpers that the other three RTOSes ship no
# equivalent of.  There is no Kconfig granularity to keep the API-
# entry checks while dropping the internal-debug ones, so we accept
# the parity-correct build (~519 k -> ~205 k SEM throughput) over a
# lighter but strictly-less-checked one.
CONFIG_RUNTIME_ERROR_CHECKS=y
CONFIG_ASSERT=y
CONFIG_ASSERT_LEVEL=2

# -----------------------------------------------------------------------------
# Mutex priority inheritance is unconditional in current Zephyr — no
# Kconfig switch.  See the parity comment at the top of this file.
# CONFIG_PRIORITY_CEILING (default -127 = no cap) sets the maximum
# priority boost the kernel will apply to a holder.  Left at default
# for parity with the unconditional inheritance the other kernels
# provide.

# -----------------------------------------------------------------------------
# Console / log routing for KVB benchmark output
# -----------------------------------------------------------------------------
CONFIG_SERIAL=y
CONFIG_CONSOLE=y
CONFIG_UART_CONSOLE=y
CONFIG_PRINTK=y
# Suppress Zephyr's startup banner so the KVB log starts clean — every
# other KVB port writes the suite header as its very first UART output.
CONFIG_BOOT_BANNER=n

# Disable Zephyr's logging subsystem — KVB writes its own line-oriented
# log directly via printk.  Mirrors how the other ports use raw UART
# without an intermediate logging framework.
CONFIG_LOG=n

# -----------------------------------------------------------------------------
# Application thread stack (KVB runner runs in main())
# -----------------------------------------------------------------------------
# The runner runs in main().  KVB_RUNNER_STACK_SIZE in
# kvb_config_zephyr.h is the USABLE stack size; the Zephyr main
# thread's stack is sized via this Kconfig and must match.
CONFIG_MAIN_STACK_SIZE=2048

# -----------------------------------------------------------------------------
# Idle thread stack
# -----------------------------------------------------------------------------
CONFIG_IDLE_STACK_SIZE=512

# -----------------------------------------------------------------------------
# C library — picolibc (NCS default for nrf52)
# -----------------------------------------------------------------------------
# NCS selects CONFIG_PICOLIBC=y as its default libc on Cortex-M targets;
# we accept that default rather than forcing CONFIG_NEWLIB_LIBC=y.  The
# KVB port uses only printk() (Zephyr-internal, not libc-routed) and
# snprintf() / memset() / memcpy() at thread-init time — none of which
# are on the measurement hot path.  Choice of libc therefore has no
# observable effect on any KVB throughput number.
#
# Float-aware printf is OFF in this build (KVB never formats floats).
CONFIG_PICOLIBC_IO_FLOAT=n

# -----------------------------------------------------------------------------
# Hardware features explicitly NOT used by KVB
# -----------------------------------------------------------------------------
CONFIG_BT=n
CONFIG_NETWORKING=n
CONFIG_USB_DEVICE_STACK=n

# IRQ responsiveness probe uses a normal target IRQ on Nordic Cortex-M
# boards through Zephyr IRQ_CONNECT.  Keep irq_offload disabled because
# it is a Zephyr test helper and can be gated by test-only Kconfig
# dependencies in NCS builds.
# CONFIG_IRQ_OFFLOAD is not set
```

## src/main.c
```c
/* SPDX-License-Identifier: MIT
 *
 * Application entry for the KVB benchmark suite on Zephyr.
 *
 * Zephyr starts the kernel before main(), so the application thread
 * is already a real kernel thread (priority CONFIG_MAIN_THREAD_PRIORITY,
 * stack CONFIG_MAIN_STACK_SIZE).
 *
 * kvb_zephyr_start_default() (in KVB/ports/kernels/zephyr/
 * kvb_port_zephyr.c) lifts this thread to KVB_PRIORITY_HIGHEST,
 * registers the default tests, and runs the KVB runner.  When the
 * runner returns the application falls through to the Zephyr idle
 * thread — there is no exit; the device sits idle until reset.
 *
 * Identical for every board.  Board / SoC selection happens via
 * `west build -b <board>` at build time.
 */

#include "kvb_zephyr_port.h"

int main(void)
{
    return kvb_zephyr_start_default();
}
```

## include/kvb_config_zephyr.h
```c
/* SPDX-License-Identifier: MIT
 *
 * KVB build configuration for the Zephyr target — board-agnostic.
 *
 * Force-included into every TU via the CMakeLists.txt -include flag
 * so the per-target overrides land before kvb_config.h's defaults.
 *
 * These defaults assume a "reasonable" Zephyr board: at least 32 KB
 * SRAM, at least 128 KB flash.  The vast majority of Zephyr-supported
 * boards meet that bar with ample margin.  If you target a tighter
 * device (say, an 8 KB SRAM Cortex-M0+ — possible on Zephyr but
 * uncommon), drop a board-specific override into a per-board file
 * (see boards/README.md) or pass -D values on the cmake command line.
 *
 * Identical safety profile across every kernel in the KVB comparison —
 * see prj.conf for the per-feature parity rationale.
 */
#ifndef KVB_CONFIG_ZEPHYR_H
#define KVB_CONFIG_ZEPHYR_H

/* ----- Tick rate / CPU clock metadata ------------------------------- *
 *
 * KVB_CORE_CLOCK_HZ is the CPU clock printed in the run metadata.  It is
 * not necessarily the same as kvb_platform_cycle_frequency_hz(): Zephyr can
 * expose a platform timer as its cycle source while the CPU runs faster.
 *
 * KVB_TICK_HZ matches CONFIG_SYS_CLOCK_TICKS_PER_SEC in prj.conf.
 * Both must agree — keep them at 1000 unless you change both. */
#if defined(CONFIG_SOC_NRF54L15_CPUAPP) || defined(CONFIG_SOC_NRF54L15) || \
    defined(CONFIG_SOC_SERIES_NRF54LX) || defined(CONFIG_SOC_SERIES_NRF54L)
#define KVB_CORE_CLOCK_HZ       128000000u
#elif defined(CONFIG_SOC_NRF52832) || defined(CONFIG_SOC_NRF52833) || \
      defined(CONFIG_SOC_NRF52840) || defined(CONFIG_SOC_SERIES_NRF52X)
#define KVB_CORE_CLOCK_HZ       64000000u
#endif

#define KVB_TICK_HZ             1000u

/* ----- Measurement windows ------------------------------------------ */

/* 10-second window — same as the v2.0 KVB report on STM32F0308.  Drops
 * tick-edge slop to ~0.04 % of the window.  Each test takes 10 s, so
 * the full 6-test suite takes ~60 s. */
#define KVB_MEASUREMENT_MS      10000u

#define KVB_WARMUP_MS           100u

/* ----- Thread / runner stacks --------------------------------------- *
 *
 * USABLE stack sizes.  The Zephyr port maps these directly onto
 * K_THREAD_STACK_DEFINE(name, size); Zephyr internally adds its own
 * per-thread overhead (TLS, MPU guard region) outside the usable area.
 * No KVB_THREAD_BUF_SIZE round-up applies to Zephyr — the caller-
 * provided block is purely usable stack. */

#define KVB_RUNNER_STACK_SIZE   2048u   /* matches CONFIG_MAIN_STACK_SIZE */
#define KVB_DEFAULT_STACK_SIZE  1024u   /* per-worker usable stack */
#define KVB_TEST_THREAD_STACK_SIZE   KVB_DEFAULT_STACK_SIZE
#define KVB_SCHED_WORKER_STACK_SIZE  KVB_TEST_THREAD_STACK_SIZE
#define KVB_RT_THREAD_STACK_SIZE     KVB_TEST_THREAD_STACK_SIZE
#define KVB_SYNC_THREAD_STACK_SIZE   KVB_TEST_THREAD_STACK_SIZE

/* ----- Worker count ------------------------------------------------- */

#define KVB_WORKER_THREAD_COUNT 3u

/* ----- Queue / log sizing ------------------------------------------- */

#define KVB_QUEUE_DEPTH         8u
#define KVB_QUEUE_MESSAGE_SIZE  16u
#define KVB_LOG_BUFFER_SIZE     256u

/* ----- Throughput tuning -------------------------------------------- */

#define KVB_MAX_REGISTERED_TESTS 16u
#define KVB_THROUGHPUT_BATCH    256u

#define KVB_ENABLE_RT_TESTS          1u

/* ----- Test selection ----------------------------------------------- */

/* TIME_SLEEP_001 strict-minimum mode:
 *
 *   0 = permissive (sleep may wake on the (N-1)th tick boundary if the
 *       request was issued mid-tick); matches Zephyr's documented
 *       k_sleep behavior of "at least N ticks but may be less when the
 *       call lands very close to a tick boundary"
 *   1 = strict (require >= N tick periods of wall-clock time)
 *
 * Set to 0 here for cross-port consistency with the published v2.0
 * KVB report on STM32F0308 (which also uses the permissive setting). */
#define KVB_SLEEP_TEST_STRICT_MINIMUM  0

#endif /* KVB_CONFIG_ZEPHYR_H */
```

## src/kvb_platform_zephyr.c
```c
/* SPDX-License-Identifier: MIT
 *
 * KVB platform layer for Zephyr — board-agnostic with ARM DWT timing when
 * available.
 *
 * On Cortex-M3/M4/M7/M33/M55 targets, KVB uses DWT CYCCNT when it is
 * usable at runtime.  That keeps nRF52832 measurements on the 64 MHz
 * CPU-cycle counter instead of Zephyr's low-resolution uptime path.
 * If CYCCNT is unavailable or does not advance at runtime, the port falls
 * back to Zephyr k_cycle_get_64()/k_cycle_get_32() and scales that source
 * to CPU-cycle-equivalent units for comparable KVB output.
 */

#include <stddef.h>
#include <stdint.h>
#include <stdio.h>

#include <zephyr/kernel.h>
#include <zephyr/sys/printk.h>
#include <zephyr/version.h>
#include <zephyr/irq.h>
#if defined(CONFIG_IRQ_OFFLOAD)
#include <zephyr/irq_offload.h>
#endif

#if defined(CONFIG_ARM) && defined(CONFIG_CPU_CORTEX_M)
#include <cmsis_core.h>
#endif

#include "kvb_platform_port.h"
#include "kvb_config.h"

#if defined(__ARM_ARCH_6M__)
#  define KVB_ARCH_NAME "ARMv6-M"
#elif defined(__ARM_ARCH_7M__)
#  define KVB_ARCH_NAME "ARMv7-M"
#elif defined(__ARM_ARCH_7EM__)
#  define KVB_ARCH_NAME "ARMv7E-M"
#elif defined(__ARM_ARCH_8M_BASE__)
#  define KVB_ARCH_NAME "ARMv8-M Baseline"
#elif defined(__ARM_ARCH_8M_MAIN__)
#  define KVB_ARCH_NAME "ARMv8-M Mainline"
#elif defined(__ARM_ARCH_8_1M_MAIN__)
#  define KVB_ARCH_NAME "ARMv8.1-M Mainline"
#elif defined(__riscv) && (__riscv_xlen == 32)
#  define KVB_ARCH_NAME "RISC-V RV32"
#elif defined(__riscv) && (__riscv_xlen == 64)
#  define KVB_ARCH_NAME "RISC-V RV64"
#elif defined(__x86_64__)
#  define KVB_ARCH_NAME "x86-64"
#elif defined(__i386__)
#  define KVB_ARCH_NAME "x86"
#elif defined(__aarch64__)
#  define KVB_ARCH_NAME "AArch64"
#else
#  define KVB_ARCH_NAME "unknown-arch"
#endif

#if defined(CONFIG_ARM) && defined(CONFIG_CPU_CORTEX_M) && \
    defined(DWT) && defined(CoreDebug) && defined(DWT_CTRL_CYCCNTENA_Msk) && \
    defined(CoreDebug_DEMCR_TRCENA_Msk) && (!defined(__CORTEX_M) || (__CORTEX_M >= 3))
#define KVB_ZEPHYR_USE_DWT 1
#else
#define KVB_ZEPHYR_USE_DWT 0
#endif

#if KVB_ZEPHYR_USE_DWT
extern uint32_t SystemCoreClock;
static uint32_t g_dwt_last;
static uint64_t g_dwt_high;
static uint8_t  g_dwt_ready;
static uint8_t  g_dwt_usable;
static uint8_t  g_dwt_runtime_reject;

static void kvb_zephyr_dwt_unlock(void)
{
#if defined(DWT_BASE) && \
    (defined(DWT_LAR_KEY) || defined(DWT_LAR_KEY_Msk) || defined(DWT_LAR_PRESENT))
    *((volatile uint32_t *)(DWT_BASE + 0xFB0u)) = 0xC5ACCE55u;
#endif
}

static void kvb_zephyr_dwt_enable(void)
{
    CoreDebug->DEMCR |= CoreDebug_DEMCR_TRCENA_Msk;
    kvb_zephyr_dwt_unlock();
    DWT->CTRL |= DWT_CTRL_CYCCNTENA_Msk;
    __DSB();
    __ISB();
}

static uint8_t kvb_zephyr_dwt_advances(void)
{
    uint32_t start;
    uint32_t end;
    volatile uint32_t spin;

    kvb_zephyr_dwt_enable();
    start = DWT->CYCCNT;
    for (spin = 0u; spin < 2048u; ++spin) {
        __NOP();
    }
    __DSB();
    __ISB();
    end = DWT->CYCCNT;

    return (end != start) ? 1u : 0u;
}

static void kvb_zephyr_dwt_reject_runtime(void)
{
    g_dwt_usable = 0u;
    g_dwt_runtime_reject = 1u;
    printk("[KVB] CYCLE DWT runtime stall detected — switched to k_cycle_get fallback\n");
}

static void kvb_zephyr_dwt_init(void)
{
    if (g_dwt_ready != 0u) {
        return;
    }

    kvb_zephyr_dwt_enable();
    DWT->CYCCNT = 0u;
    __DSB();
    __ISB();

    g_dwt_last = DWT->CYCCNT;
    g_dwt_high = 0u;
    g_dwt_runtime_reject = 0u;
    g_dwt_usable = kvb_zephyr_dwt_advances();
    g_dwt_last = DWT->CYCCNT;
    g_dwt_ready = 1u;
}

static uint8_t kvb_zephyr_dwt_runtime_ok(uint32_t *now)
{
    if (now == NULL || g_dwt_usable == 0u || g_dwt_runtime_reject != 0u) {
        return 0u;
    }

    /* A same-value read after a full platform call should not happen on a
     * usable CPU-cycle counter.  nRF54L15 Zephyr can leave CYCCNT present but
     * stopped after idle/sleep transitions.  Detect that condition here and
     * fall back instead of reporting zero-cycle PASS metrics. */
    if (*now == g_dwt_last) {
        if (kvb_zephyr_dwt_advances() == 0u) {
            kvb_zephyr_dwt_reject_runtime();
            return 0u;
        }
        *now = DWT->CYCCNT;
    }

    return 1u;
}

static uint64_t kvb_zephyr_dwt_count64(void)
{
    uint32_t now;

    kvb_zephyr_dwt_init();
    if (g_dwt_usable == 0u || g_dwt_runtime_reject != 0u) {
        return 0u;
    }

    kvb_zephyr_dwt_enable();
    now = DWT->CYCCNT;

    if (kvb_zephyr_dwt_runtime_ok(&now) == 0u) {
        return 0u;
    }

    if (now < g_dwt_last) {
        g_dwt_high += (1ull << 32);
    }

    g_dwt_last = now;
    return g_dwt_high | (uint64_t)now;
}
#endif

static uint64_t kvb_zephyr_scale_to_cpu_cycles(uint64_t hw_cycles)
{
    const uint64_t hw_hz = (uint64_t)sys_clock_hw_cycles_per_sec();
    const uint64_t cpu_hz = (uint64_t)KVB_CORE_CLOCK_HZ;

    if (hw_hz == 0u || cpu_hz == 0u) {
        return hw_cycles;
    }

    if (hw_hz == cpu_hz) {
        return hw_cycles;
    }

    /* Avoid overflow for long-running counters.  KVB measurements are short,
     * but split quotient/remainder scaling keeps the conversion well behaved
     * if the board has been running for a while before the suite starts. */
    return ((hw_cycles / hw_hz) * cpu_hz) +
           (((hw_cycles % hw_hz) * cpu_hz) / hw_hz);
}

uint32_t kvb_platform_cycle_frequency_hz(void)
{
#if KVB_ZEPHYR_USE_DWT
    kvb_zephyr_dwt_init();
    if (g_dwt_usable != 0u && SystemCoreClock != 0u) {
        return SystemCoreClock;
    }
#endif

    /* Zephyr's k_cycle_get_*() can expose a low-frequency platform timer
     * instead of the CPU clock.  Report CPU-cycle-equivalent units so KVB
     * cycle metrics remain comparable with the IOsonata-backed ports. */
    return (uint32_t)KVB_CORE_CLOCK_HZ;
}

uint64_t kvb_platform_cycle_count(void)
{
#if KVB_ZEPHYR_USE_DWT
    kvb_zephyr_dwt_init();
    if (g_dwt_usable != 0u && g_dwt_runtime_reject == 0u) {
        const uint64_t dwt_cycles = kvb_zephyr_dwt_count64();

        if (g_dwt_usable != 0u && g_dwt_runtime_reject == 0u) {
            return dwt_cycles;
        }
    }
#endif
    return kvb_zephyr_scale_to_cpu_cycles(k_cycle_get_64());
}

uint32_t kvb_platform_cycle_count32(void)
{
    /* Route the 32-bit API through the same source-selection logic as the
     * 64-bit API.  Do not read DWT->CYCCNT directly here: if Zephyr leaves
     * CYCCNT stopped, direct reads produce zero IRQ-latency metrics while the
     * 64-bit path has already rejected DWT and selected the fallback source. */
    return (uint32_t)kvb_platform_cycle_count();
}

uint64_t kvb_platform_time_us(void)
{
    /* Use Zephyr uptime for wall-clock measurements.
     *
     * The DWT CYCCNT path is useful for active-loop cycle counting, but it is
     * not a stable wall-clock source across k_sleep()/idle on all Cortex-M33
     * targets.  Zephyr uptime is driven by the kernel timer and is the correct
     * source for sleep-duration validation.
     */
#if KVB_ZEPHYR_USE_DWT
    if (g_dwt_usable != 0u && g_dwt_runtime_reject == 0u) {
        kvb_zephyr_dwt_enable();
    }
#endif
    return (uint64_t)k_ticks_to_us_floor64(k_uptime_ticks());
}

void kvb_platform_log_write(const char *data, size_t len)
{
    if (data == NULL || len == 0u) {
        return;
    }

    printk("%.*s", (int)len, data);
}

void kvb_platform_log_flush(void)
{
}

const char *kvb_platform_board_name(void)
{
    return CONFIG_BOARD;
}

const char *kvb_platform_cpu_name(void)
{
    static char s_cpu_name[64];

    if (s_cpu_name[0] == '\0') {
        const uint32_t hz = KVB_CORE_CLOCK_HZ;
        const unsigned mhz = (unsigned)((hz + 500000u) / 1000000u);

        (void)snprintf(s_cpu_name, sizeof s_cpu_name,
                       "%s @ %u MHz (%s)",
                       KVB_ARCH_NAME,
                       mhz,
                       CONFIG_SOC);
    }

    return s_cpu_name;
}

const char *kvb_platform_timing_source(void)
{
#if KVB_ZEPHYR_USE_DWT
    kvb_zephyr_dwt_init();
    if (g_dwt_usable != 0u && g_dwt_runtime_reject == 0u) {
        return "DWT cycles with runtime fallback + Zephyr uptime";
    }
#endif
    if ((uint32_t)sys_clock_hw_cycles_per_sec() != KVB_CORE_CLOCK_HZ) {
        return "Zephyr cycles scaled to CPU clock + uptime";
    }
    return "Zephyr cycles + uptime";
}

const char *kvb_platform_safety_profile(void)
{
    /* In current Zephyr, API-entry parameter validation is split
     * across two mechanisms: CHECKIF() (gated by the "Error checking
     * behavior for CHECK macro" Kconfig choice; KVB pins
     * RUNTIME_ERROR_CHECKS=y) and __ASSERT() (gated by CONFIG_ASSERT;
     * KVB pins CONFIG_ASSERT=y).  Both are required for parity with
     * FreeRTOS configASSERT, ThreadX _txe_*, and TaktOS API-entry
     * checks.  We report a combined tag that lists each layer that
     * is actually compiled in.
     */
#if defined(CONFIG_HW_STACK_PROTECTION) && defined(CONFIG_STACK_SENTINEL) && \
    defined(CONFIG_RUNTIME_ERROR_CHECKS) && defined(CONFIG_ASSERT)
    return "stack_guard+sentinel+runtime_checks+assert";
#elif defined(CONFIG_STACK_SENTINEL) && \
    defined(CONFIG_RUNTIME_ERROR_CHECKS) && defined(CONFIG_ASSERT)
    return "sentinel+runtime_checks+assert";
#elif defined(CONFIG_RUNTIME_ERROR_CHECKS) && defined(CONFIG_ASSERT)
    return "runtime_checks+assert";
#elif defined(CONFIG_RUNTIME_ERROR_CHECKS)
    return "runtime_checks";
#elif defined(CONFIG_ASSERT)
    return "assert";
#else
    return "minimal";
#endif
}

const char *kvb_platform_heap_profile(void)
{
#if defined(CONFIG_HEAP_MEM_POOL_SIZE) && (CONFIG_HEAP_MEM_POOL_SIZE > 0)
    return "on";
#else
    return "off";
#endif
}


/* --------------------------------------------------------------------------
 * IRQ responsiveness probe
 * --------------------------------------------------------------------------
 *
 * Do not depend on CONFIG_IRQ_OFFLOAD for the Nordic Zephyr runs.  In current
 * Zephyr/NCS, irq_offload() is a test helper whose Kconfig symbol may be
 * hidden behind test-only dependencies; setting CONFIG_IRQ_OFFLOAD=y in
 * prj.conf can therefore still leave the symbol disabled.  KVB needs a normal
 * target IRQ, so Nordic Cortex-M builds wire one spare NVIC software/event IRQ
 * directly through Zephyr's IRQ_CONNECT path.
 */

#define KVB_ZEPHYR_HW_IRQ_PROBE 0

#if defined(CONFIG_ARM) && defined(CONFIG_CPU_CORTEX_M)
#if defined(CONFIG_SOC_NRF52832) || defined(CONFIG_SOC_NRF52833) || \
    defined(CONFIG_SOC_NRF52840) || defined(CONFIG_SOC_SERIES_NRF52X)
#undef KVB_ZEPHYR_HW_IRQ_PROBE
#define KVB_ZEPHYR_HW_IRQ_PROBE 1
#define KVB_ZEPHYR_IRQ_PROBE_IRQ  SWI3_EGU3_IRQn
#define KVB_ZEPHYR_IRQ_PROBE_NAME "NVIC SWI3_EGU3"
#elif defined(CONFIG_SOC_NRF54L15_CPUAPP) || defined(CONFIG_SOC_NRF54L15) || \
      defined(CONFIG_SOC_SERIES_NRF54LX) || defined(CONFIG_SOC_SERIES_NRF54L)
#undef KVB_ZEPHYR_HW_IRQ_PROBE
#define KVB_ZEPHYR_HW_IRQ_PROBE 1
#define KVB_ZEPHYR_IRQ_PROBE_IRQ  28
#define KVB_ZEPHYR_IRQ_PROBE_NAME "NVIC SWI00"
#endif
#endif

#if KVB_ZEPHYR_HW_IRQ_PROBE
#ifndef __NVIC_PRIO_BITS
#define __NVIC_PRIO_BITS 3u
#endif
#define KVB_ZEPHYR_IRQ_PROBE_PRIO \
    ((unsigned int)((KVB_IRQ_PROBE_PRIORITY) >> (8u - __NVIC_PRIO_BITS)))

static KvbPlatformIrqHandler g_zephyr_irq_probe_handler;
static void *g_zephyr_irq_probe_arg;
static uint8_t g_zephyr_irq_probe_ready;

static void kvb_zephyr_irq_probe_isr(const void *parameter)
{
    (void)parameter;

    if (g_zephyr_irq_probe_handler != NULL) {
        g_zephyr_irq_probe_handler(g_zephyr_irq_probe_arg);
    }
}

static void kvb_zephyr_irq_probe_barrier(void)
{
    __DSB();
    __ISB();
}
#elif defined(CONFIG_IRQ_OFFLOAD)
static KvbPlatformIrqHandler g_zephyr_irq_probe_handler;
static void *g_zephyr_irq_probe_arg;

static void kvb_zephyr_irq_probe_offload(const void *parameter)
{
    (void)parameter;

    if (g_zephyr_irq_probe_handler != NULL) {
        g_zephyr_irq_probe_handler(g_zephyr_irq_probe_arg);
    }
}
#endif

KvbStatus kvb_platform_irq_probe_init(KvbPlatformIrqHandler handler, void *arg)
{
#if KVB_ZEPHYR_HW_IRQ_PROBE
    IRQ_CONNECT(KVB_ZEPHYR_IRQ_PROBE_IRQ,
                KVB_ZEPHYR_IRQ_PROBE_PRIO,
                kvb_zephyr_irq_probe_isr,
                NULL,
                0);

    if (handler == NULL) {
        return KVB_ERR_INVALID_ARG;
    }

    g_zephyr_irq_probe_handler = handler;
    g_zephyr_irq_probe_arg = arg;
    g_zephyr_irq_probe_ready = 1u;

    NVIC_ClearPendingIRQ((IRQn_Type)KVB_ZEPHYR_IRQ_PROBE_IRQ);
    irq_enable((unsigned int)KVB_ZEPHYR_IRQ_PROBE_IRQ);
    kvb_zephyr_irq_probe_barrier();
    return KVB_OK;
#elif defined(CONFIG_IRQ_OFFLOAD)
    if (handler == NULL) {
        return KVB_ERR_INVALID_ARG;
    }

    g_zephyr_irq_probe_handler = handler;
    g_zephyr_irq_probe_arg = arg;
    return KVB_OK;
#else
    (void)handler;
    (void)arg;
    return KVB_ERR_UNSUPPORTED;
#endif
}

KvbStatus kvb_platform_irq_probe_trigger(void)
{
#if KVB_ZEPHYR_HW_IRQ_PROBE
    if (g_zephyr_irq_probe_ready == 0u) {
        return KVB_ERR_UNSUPPORTED;
    }

    NVIC_SetPendingIRQ((IRQn_Type)KVB_ZEPHYR_IRQ_PROBE_IRQ);
    kvb_zephyr_irq_probe_barrier();
    return KVB_OK;
#elif defined(CONFIG_IRQ_OFFLOAD)
    if (g_zephyr_irq_probe_handler == NULL) {
        return KVB_ERR_UNSUPPORTED;
    }

    irq_offload(kvb_zephyr_irq_probe_offload, NULL);
    return KVB_OK;
#else
    return KVB_ERR_UNSUPPORTED;
#endif
}

KvbStatus kvb_platform_irq_probe_disable(void)
{
#if KVB_ZEPHYR_HW_IRQ_PROBE
    if (g_zephyr_irq_probe_ready == 0u) {
        return KVB_ERR_UNSUPPORTED;
    }

    irq_disable((unsigned int)KVB_ZEPHYR_IRQ_PROBE_IRQ);
    NVIC_ClearPendingIRQ((IRQn_Type)KVB_ZEPHYR_IRQ_PROBE_IRQ);
    g_zephyr_irq_probe_handler = NULL;
    g_zephyr_irq_probe_arg = NULL;
    g_zephyr_irq_probe_ready = 0u;
    kvb_zephyr_irq_probe_barrier();
    return KVB_OK;
#elif defined(CONFIG_IRQ_OFFLOAD)
    g_zephyr_irq_probe_handler = NULL;
    g_zephyr_irq_probe_arg = NULL;
    return KVB_OK;
#else
    return KVB_ERR_UNSUPPORTED;
#endif
}

const char *kvb_platform_irq_probe_name(void)
{
#if KVB_ZEPHYR_HW_IRQ_PROBE
    return KVB_ZEPHYR_IRQ_PROBE_NAME;
#elif defined(CONFIG_IRQ_OFFLOAD)
    return "Zephyr irq_offload";
#else
    return "none";
#endif
}
```
