## CMakeLists.txt
```
# SPDX-License-Identifier: MIT
#
# CMake configuration for the KVB benchmark suite on nRF54L15-DK with Zephyr.
#
# Build:
#
#   cd KVB/Targets/nRF54L15-DK/Zephyr_nRF54L15-DK_KvbSuite/
#   west build -p always -b nrf54l15dk/nrf54l15/cpuapp .
#   west flash
#
# The build pulls KVB source from KVB/src and KVB/ports/kernels/zephyr,
# the platform layer from KVB/Targets/nRF54L15-DK/src, and links it as a
# Zephyr application image.  Zephyr starts the kernel before main();
# main() then calls kvb_zephyr_start_default() which runs the KVB runner
# from the application thread (lifted to KVB_PRIORITY_HIGHEST by the
# Zephyr port).

cmake_minimum_required(VERSION 3.20.0)

# KVB_ROOT points at the KVB tree root.
# This CMakeLists.txt lives at: KVB/Targets/nRF54L15-DK/Zephyr_nRF54L15-DK_KvbSuite/
# So three levels up is the KVB root.
set(KVB_ROOT ${CMAKE_CURRENT_SOURCE_DIR}/../../..)

# Per-target board+kernel platform implementation lives next to this file.
set(KVB_TARGET_ROOT ${CMAKE_CURRENT_SOURCE_DIR}/..)

find_package(Zephyr REQUIRED HINTS $ENV{ZEPHYR_BASE})
project(kvb_zephyr_nrf54l15dk LANGUAGES C CXX ASM)

# ----- KVB sources --------------------------------------------------------
# Core framework (kernel-agnostic).
target_sources(app PRIVATE
    ${KVB_ROOT}/src/core/kvb_default_tests.c
    ${KVB_ROOT}/src/core/kvb_log.c
    ${KVB_ROOT}/src/core/kvb_platform_default.c
    ${KVB_ROOT}/src/core/kvb_registry.c
    ${KVB_ROOT}/src/core/kvb_result.c
    ${KVB_ROOT}/src/core/kvb_runner.c
)

# Test bodies.
target_sources(app PRIVATE
    ${KVB_ROOT}/src/tests/sched/kvb_test_sched.c
    ${KVB_ROOT}/src/tests/sync/kvb_test_sync.c
    ${KVB_ROOT}/src/tests/ipc/kvb_test_ipc.c
    ${KVB_ROOT}/src/tests/time/kvb_test_time.c
)

# Zephyr kernel port.
target_sources(app PRIVATE
    ${KVB_ROOT}/ports/kernels/zephyr/kvb_port_zephyr.c
)

# Per-target platform layer (board ID strings, microsecond clock).
target_sources(app PRIVATE
    ${KVB_TARGET_ROOT}/src/kvb_platform_nrf54l15dk.c
)

# Application entry point — this directory's main.c.
target_sources(app PRIVATE
    src/main.c
)

# ----- Include paths ------------------------------------------------------
target_include_directories(app PRIVATE
    ${KVB_ROOT}/include
    ${KVB_ROOT}/ports/kernels/zephyr
    ${KVB_ROOT}/src/tests
    ${KVB_TARGET_ROOT}/include
)

# ----- KVB port + target identification ----------------------------------
target_compile_definitions(app PRIVATE
    KVB_PORT_ZEPHYR=1
    KVB_TARGET_NRF54L15DK=1
)

# ----- Per-target KVB knobs ----------------------------------------------
# kvb_config_nrf54l15dk_zephyr.h is force-included into every TU so the
# board-specific overrides (KVB_CORE_CLOCK_HZ, KVB_TICK_HZ, stack sizes,
# 10-second measurement window) land before kvb_config.h's defaults.
target_compile_options(app PRIVATE
    -include kvb_config_nrf54l15dk_zephyr.h
)
```

## prj.conf
```kconfig
# =============================================================================
# Zephyr Kconfig settings for KVB benchmark on nRF54L15-DK.
#
# v2: removed three symbols that were either auto-derived or removed from
# the current Zephyr Kconfig tree:
#
#   - CONFIG_PREEMPT_ENABLED=y           (def_bool, auto from NUM_PREEMPT_PRIORITIES)
#   - CONFIG_NUM_COOP_PRIORITIES=0       (breaks Zephyr defaults that assume
#                                         negative priorities exist; leave at
#                                         default 16)
#   - CONFIG_KERNEL_MEM_POOL=n           (removed in Zephyr 2.x; setting
#                                         HEAP_MEM_POOL_SIZE=0 alone disables
#                                         the heap)
#
# These settings are chosen for FEATURE PARITY with the other KVB ports
# (TaktOS, FreeRTOS V11.1+, Eclipse ThreadX 6.x).  See the KVB v3.0
# comparison report's methodology section for the full rationale.
#
# Equivalent runtime safety on every kernel:
#
#   - Stack overflow detection: always-on
#       TaktOS:    sentinel paint + check at every context switch
#       FreeRTOS:  configCHECK_FOR_STACK_OVERFLOW = 2 (canary)
#       ThreadX:   TX_ENABLE_STACK_CHECKING (sentinel)
#       Zephyr:    CONFIG_STACK_SENTINEL = y (canary at every switch)
#                  CONFIG_HW_STACK_PROTECTION = y (M33 MPU stack guard)
#
#   - Null parameter / bad object check: always-on
#       TaktOS:    inline check at API entry, no extra frame
#       FreeRTOS:  configASSERT macro inlined at call sites
#       ThreadX:   _txe_* wrapper functions (real call frame per API)
#       Zephyr:    CONFIG_ASSERT = y (inline assertions in k_* APIs)
#
#   - Mutex priority inheritance: enabled
#       Zephyr:    unconditional in k_mutex (no Kconfig — always-on
#                  in current Zephyr; older guides mention a removed
#                  CONFIG_MUTEX_PRIORITY_INHERITANCE symbol)

# -----------------------------------------------------------------------------
# Kernel scheduling shape
# -----------------------------------------------------------------------------
# CONFIG_PREEMPT_ENABLED is auto-derived from NUM_PREEMPT_PRIORITIES > 0.
# Setting NUM_PREEMPT_PRIORITIES=15 (the default) is enough.

# Disable round-robin timeslicing — KVB tests rely on explicit yield to
# isolate cooperative scheduler latency from preemption events.  TaktOS
# and ThreadX KVB builds also disable timeslicing.
CONFIG_TIMESLICING=n

# 1000 Hz tick — matches every other KVB port.  TIME_SLEEP_001
# requested-vs-actual tolerance is computed against this tick period.
CONFIG_SYS_CLOCK_TICKS_PER_SEC=1000

# Leave NUM_COOP_PRIORITIES at its default (16).  Zephyr internals
# (system workqueue, BLE host stack defaults, etc.) place several threads
# at negative priorities; forcing NUM_COOP_PRIORITIES=0 breaks those
# placements at link time.  KVB does not need cooperative priorities
# itself — its priority mapping uses preemptive 0..14 — but the
# infrastructure around KVB does.

# 15 preemptive priority levels.  KVB uses 5 canonical levels
# (LOWEST..HIGHEST) which the Zephyr port maps into 1..14.
CONFIG_NUM_PREEMPT_PRIORITIES=15

# -----------------------------------------------------------------------------
# Memory model: static allocation only
# -----------------------------------------------------------------------------
# Setting HEAP_MEM_POOL_SIZE=0 instructs Zephyr not to define the
# system heap at all.  k_malloc() is not used by KVB; all kernel
# objects are caller-supplied.  Matches TaktOS (inline-in-handle),
# FreeRTOS V11+ (static handles + heap_4 fallback for the V11 ARM_CM0
# split-port quirk on M0 — does not apply on M33), and ThreadX
# (port-private static slot pool).
CONFIG_HEAP_MEM_POOL_SIZE=0

# -----------------------------------------------------------------------------
# Stack overflow detection (parity)
# -----------------------------------------------------------------------------
CONFIG_STACK_SENTINEL=y
# nRF54L15 is Cortex-M33 — full ARMv8-M MPU available; use HW stack
# protection in addition to the sentinel.  TaktOS production builds on
# M33 use the same MPU stack guard region, so this is feature-parity
# (NOT a Zephyr-only advantage).  FreeRTOS and ThreadX rely on the
# sentinel only on this target.
CONFIG_HW_STACK_PROTECTION=y
CONFIG_THREAD_STACK_INFO=y
CONFIG_INIT_STACKS=y

# -----------------------------------------------------------------------------
# Parameter / object validation (parity with FreeRTOS configASSERT
# and ThreadX _txe_* wrappers)
# -----------------------------------------------------------------------------
CONFIG_ASSERT=y
CONFIG_ASSERT_LEVEL=2

# -----------------------------------------------------------------------------
# Mutex semantics
# -----------------------------------------------------------------------------
# k_mutex priority inheritance is ALWAYS-ON in current Zephyr (4.x).
# There is no Kconfig switch — the priority-boost code in kernel/mutex.c
# is unconditional.  Older guides referencing CONFIG_MUTEX_PRIORITY_
# INHERITANCE are out of date; the symbol was removed and the feature
# made unconditional.
#
# Parity with TaktOS (PI required), FreeRTOS (xSemaphoreCreateRecursive
# Mutex with configUSE_MUTEXES=1 inherits priority), ThreadX (TX_INHERIT
# attribute on tx_mutex_create) is therefore intrinsic to k_mutex,
# not something this prj.conf needs to enable.
#
# CONFIG_PRIORITY_CEILING (default -128 = unbounded inheritance) sets
# the cap on how high the kernel will boost the holder's priority.  Left
# at default for parity with the unconditional inheritance the other
# kernels provide.

# -----------------------------------------------------------------------------
# Console / log routing for KVB benchmark output
# -----------------------------------------------------------------------------
CONFIG_SERIAL=y
CONFIG_CONSOLE=y
CONFIG_UART_CONSOLE=y
CONFIG_PRINTK=y
# Suppress Zephyr's startup banner so the KVB log starts clean — every
# other KVB port writes the suite header as its very first UART output.
CONFIG_BOOT_BANNER=n

# Disable Zephyr's logging subsystem — KVB writes its own line-oriented
# log directly via printk.  Mirrors how the other ports use raw UART
# without an intermediate logging framework.
CONFIG_LOG=n

# -----------------------------------------------------------------------------
# Application thread stack (KVB runner runs in main())
# -----------------------------------------------------------------------------
# The runner runs in main().  KVB_RUNNER_STACK_SIZE in
# kvb_config_nrf54l15dk_zephyr.h is the USABLE stack size; the Zephyr
# main thread's stack is sized via this Kconfig and must match.
CONFIG_MAIN_STACK_SIZE=2048

# -----------------------------------------------------------------------------
# Idle thread stack
# -----------------------------------------------------------------------------
CONFIG_IDLE_STACK_SIZE=512

# -----------------------------------------------------------------------------
# C library — newlib for printf/snprintf parity with FreeRTOS/ThreadX builds
# -----------------------------------------------------------------------------
CONFIG_NEWLIB_LIBC=y
CONFIG_NEWLIB_LIBC_FLOAT_PRINTF=n

# -----------------------------------------------------------------------------
# Hardware features explicitly NOT used by KVB
# -----------------------------------------------------------------------------
CONFIG_BT=n
CONFIG_NETWORKING=n
CONFIG_USB_DEVICE_STACK=n
```

## boards/nrf54l15dk_nrf54l15_cpuapp.overlay
```dts
/* SPDX-License-Identifier: MIT
 *
 * Devicetree overlay for the KVB benchmark on nRF54L15-DK.
 *
 * The default board devicetree
 * (zephyr/boards/nordic/nrf54l15dk/nrf54l15dk_nrf54l15_cpuapp.dts)
 * already routes the Zephyr console to uart30, which on the nRF54L15-DK
 * appears as the J-Link CDC ACM virtual COM port over the IMCU USB
 * connector.  KVB's printk-based log output goes there directly with
 * no overlay required.
 *
 * This file is kept as an empty stub so that future KVB additions
 * (extra GPIOs for benchmark instrumentation, alternative UART pin
 * routing, etc.) have a documented home and don't get scattered
 * across prj.conf and source files.
 */

/ {
    /* No overrides required.  The board defconfig + DTS provides
     * everything KVB needs:
     *
     *   chosen { zephyr,console = &uart30; ... }
     *
     * which the prj.conf CONFIG_UART_CONSOLE=y selects automatically.
     */
};
```

## src/main.c
```c
/* SPDX-License-Identifier: MIT
 *
 * Application entry point for the KVB benchmark suite on Zephyr.
 *
 * Zephyr starts the kernel before main(), so the application thread
 * itself is already a real kernel thread with the priority configured
 * by CONFIG_MAIN_STACK_SIZE / CONFIG_MAIN_THREAD_PRIORITY.
 *
 * kvb_zephyr_start_default() (defined in
 * KVB/ports/kernels/zephyr/kvb_port_zephyr.c) re-prioritises this
 * thread to KVB_PRIORITY_HIGHEST, registers the default tests, and
 * runs the KVB runner.  When the runner returns the application falls
 * through to the Zephyr idle thread.
 */

#include "kvb_zephyr_port.h"

int main(void)
{
    return kvb_zephyr_start_default();
}
```
