## KVB/Targets/nRF54L15-DK/Zephyr_nRF54L15-DK_KvbSuite/build_l15/Kconfig/boards/Kconfig.nrf54l15dk.tmp
```kconfig
# Load board Kconfig descriptions.
osource "/opt/nordic/ncs/v3.3.0/zephyr/boards/nordic/nrf54l15dk/Kconfig.nrf54l15dk"
```
