## KVB/Targets/nRF54L15-DK/Zephyr_nRF54L15-DK_KvbSuite/build_832/Kconfig/boards/Kconfig.defconfig
```kconfig
# Load Zephyr board defconfig descriptions.
osource "/opt/nordic/ncs/v3.3.0/zephyr/boards/nordic/nrf52dk/Kconfig.defconfig"
```

## KVB/Targets/nRF54L15-DK/Zephyr_nRF54L15-DK_KvbSuite/build_832/Zephyr_nRF54L15-DK_KvbSuite/Kconfig/boards/Kconfig
```kconfig
# Load Zephyr board Kconfig descriptions.
osource "/opt/nordic/ncs/v3.3.0/zephyr/boards/nordic/nrf52dk/Kconfig"
```
